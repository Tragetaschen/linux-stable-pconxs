## Documentation/devicetree/bindings/display/mxsfb-drm.txt
```
* Freescale MXS LCD Interface (LCDIF) with KMS/DRM support

Required properties:
- compatible:	Should be "fsl,imx23-lcdif" for i.MX23.
		Should be "fsl,imx28-lcdif" for i.MX28 and i.MX6SX.
- reg:		Address and length of the register set for lcdif
- interrupts:	Should contain lcdif interrupts
- clocks:	A list of phandle + clock-specifier pairs, one for each
		entry in 'clock-names'.
- clock-names:	A list of clock names. For MXSFB it should contain:
    - "pix" for the MXSFB block clock
    - (optional) "axi", "disp_axi" for the bus interface clock on MX6SX

Required sub-nodes:
  - port: The connection to an encoder chip.

Example:

	lcdif1: lcdif@02220000 {
		compatible = "fsl,imx6sx-lcdif", "fsl,imx28-lcdif";
		reg = <0x02220000 0x4000>;
		interrupts = <GIC_SPI 5 IRQ_TYPE_LEVEL_HIGH>;
		clocks = <&clks IMX6SX_CLK_LCDIF1_PIX>,
			 <&clks IMX6SX_CLK_LCDIF_APB>,
			 <&clks IMX6SX_CLK_DISPLAY_AXI>;
		clock-names = "pix", "axi", "disp_axi";

		port {
			parallel_out: endpoint {
				remote-endpoint = <&panel_in_parallel>;
			};
		};
	};
```

## Documentation/devicetree/bindings/display/panel/ortustech,com32h3n89ulc.txt
```
OrtusTech COM32H3N89ULC Blanview 3.7" TFT-LCD panel with SPI control bus

Required properties:
- compatible: should be "ortustech,com32h3n89ulc"
- reg: address of the panel on the SPI bus
- reset-gpios: a GPIO spec for the reset pin

The panel must obey rules for SPI slave device specified in document [1].

[1]: Documentation/devicetree/bindings/spi/spi-bus.txt

Example:

	panel: panel@0 {
		compatible = "ortustech,com32h3n89ulc";
		pinctrl-names = "default";
		pinctrl-0 = <&pinctrl_panel>;
		power-supply = <&display_regulator>;
		reset-gpios = <&gpio1 21 GPIO_ACTIVE_HIGH>;
		reg = <0>;
		spi-max-frequency = <10000000>;

		port {
			panel_in_parallel: endpoint {
				remote-endpoint = <&parallel_out>;
			};
		};
	};
```

## drivers/target-systemelektronik/Kconfig
```kconfig
menuconfig TARGET_SYSTEMELEKTRONIK
	bool "Target Systemelektronik Drivers"
	depends on PCI
	default y
	help
	  This option enables support for Target Systemelektronik drivers

if TARGET_SYSTEMELEKTRONIK

config TARGET_SYSTEMELEKTRONIK_FPGA
	tristate "Target Systemelektronik FPGA"
	depends on DMA_CMA
	default y
	help
	  Say Y or M here to enable the Target Systemelektronik FPGA device driver

choice
	prompt "FPGA Type"
	default TARGET_SYSTEMELEKTRONIK_P868
	help
	  Choose your FPGA implementation

config TARGET_SYSTEMELEKTRONIK_P868
	bool "P868"
	depends on TARGET_SYSTEMELEKTRONIK_FPGA
	help
	  P868 Platform

config TARGET_SYSTEMELEKTRONIK_U100
	bool "U100"
	depends on TARGET_SYSTEMELEKTRONIK_FPGA
	help
	  U100 Platform

endchoice

endif
```
